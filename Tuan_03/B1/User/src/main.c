#include "i2c.h"

#define SSD1306_ADDR 0x78
// Hàm memset tự viết dùng cho bare-metal
void *memset(void *dst, int c, unsigned int n) {
    uint8_t *p = (uint8_t *)dst;
    while (n--) {
        *p++ = (uint8_t)c;
    }
    return dst;
}
// 1. Hàm gửi Lệnh (Command)
void SSD1306_WriteCommand(uint8_t cmd) {
    I2C_Start();
    I2C_SendAddr(SSD1306_ADDR, 0); 
    I2C_WriteData(0x00);           
    I2C_WriteData(cmd);            
    I2C_Stop();
}

// 2. Hàm gửi Dữ liệu (Data)
void SSD1306_WriteData(uint8_t data) {
    I2C_Start();
    I2C_SendAddr(SSD1306_ADDR, 0); 
    I2C_WriteData(0x40);           
    I2C_WriteData(data);           
    I2C_Stop();
}

// 3. Hàm khởi tạo màn hình (Bạn đã vô tình xóa mất hàm này)
void SSD1306_Init(void) {
    SSD1306_WriteCommand(0xC8); // Lật chiều dọc (COM Output Scan Direction)
    SSD1306_WriteCommand(0xA1); // Lật chiều ngang (Segment Re-map)
    SSD1306_WriteCommand(0xAE); // Tắt màn hình
    SSD1306_WriteCommand(0x20); // Chế độ bộ nhớ
    SSD1306_WriteCommand(0x00); // Horizontal Addressing
    SSD1306_WriteCommand(0x21); // Dải cột
    SSD1306_WriteCommand(0);    
    SSD1306_WriteCommand(127);  
    SSD1306_WriteCommand(0x22); // Dải trang
    SSD1306_WriteCommand(0);    
    SSD1306_WriteCommand(7);    
    SSD1306_WriteCommand(0x8D); // Charge Pump
    SSD1306_WriteCommand(0x14); 
    SSD1306_WriteCommand(0xAF); // Bật màn hình
}

// 4. Mảng dữ liệu ảnh (Dán 1024 byte của bạn vào đây)
const unsigned char IMAGE[1024] = {
// 128 x 64, 1024 bytes
// Pixel format: MONO_HMSB
// Algorithm: Uniform (nearest)
// Generated by img2lcd.com
  0xff, 0xff, 0xff, 0xff, 0x00, 0x00, 0x00, 0x00, 0x00, 0x00, 0x00, 0x00, 0xff, 0xff, 0xff, 0xff, 
	0xff, 0xff, 0xff, 0xff, 0x7f, 0xff, 0xff, 0xff, 0xff, 0xff, 0xff, 0xfe, 0xff, 0xff, 0xff, 0xff, 
	0xff, 0xff, 0xff, 0xff, 0x7f, 0xff, 0xff, 0xff, 0xff, 0xff, 0xff, 0xfe, 0xff, 0xff, 0xff, 0xff, 
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	0xff, 0xff, 0xff, 0xff, 0x00, 0x00, 0x00, 0x00, 0x00, 0x00, 0x00, 0x00, 0xff, 0xff, 0xff, 0xff

};

// 5. Hàm vẽ ảnh bitmap
// 5. Hàm vẽ ảnh bitmap (Đã tích hợp bộ dịch định dạng MONO_HMSB)
void SSD1306_DrawBitmap(const unsigned char* bitmap) {
    // Tạo một bộ đệm ảo 1024 byte trong RAM (Vi điều khiển của bạn có 20KB RAM nên rất thoải mái)
    uint8_t buffer[1024] = {0}; 

    // Chuyển đổi dữ liệu từ ảnh ngang (Horizontal) sang cấu trúc trang dọc (Vertical Page) của OLED
    for (int y = 0; y < 64; y++) {
        for (int x = 0; x < 128; x++) {
            // Xác định vị trí pixel trong mảng gốc của web (đọc theo hàng ngang)
            int byte_idx = (y * 128 + x) / 8;
            int bit_idx = 7 - (x % 8); // Chế độ HMSB (Bit quan trọng nhất nằm bên trái)
            
            // Nếu pixel tại vị trí này sáng (bit = 1)
            if (bitmap[byte_idx] & (1 << bit_idx)) {
                // Ánh xạ nó sang bộ đệm ảo của OLED (đọc theo cột dọc)
                int oled_byte = (y / 8) * 128 + x;
                int oled_bit = y % 8;
                buffer[oled_byte] |= (1 << oled_bit);
            }
        }
    }

    // Reset lại con trỏ màn hình OLED
    SSD1306_WriteCommand(0x21); 
    SSD1306_WriteCommand(0);    
    SSD1306_WriteCommand(127);  
    SSD1306_WriteCommand(0x22); 
    SSD1306_WriteCommand(0);    
    SSD1306_WriteCommand(7);    

    // Đổ toàn bộ bộ đệm ảo đã được dịch chuẩn xác ra màn hình
    for(int i = 0; i < 1024; i++) {
        SSD1306_WriteData(buffer[i]);
    }
}
// Hai hàm rỗng bắt buộc để linker không báo lỗi thiếu thư viện chuẩn
void SystemInit(void) {}
void _init(void) {}

int main(void) {
    // Đã đổi lại thành I2C_Init() cho khớp với thư viện mới
    I2C_Init();
    
    SSD1306_Init();
    
    SSD1306_DrawBitmap(IMAGE);

    while(1) {
    }
}
